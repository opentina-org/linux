## Documentation/devicetree/bindings/clock/allwinner,sun60i-a733-de352-clk.yaml
```yaml
# SPDX-License-Identifier: GPL-2.0
%YAML 1.2
---
$id: http://devicetree.org/schemas/clock/allwinner,sun60i-a733-de352-clk.yaml#
$schema: http://devicetree.org/meta-schemas/core.yaml#

title: Allwinner A733 DE352 DETOP Clock Controller

maintainers:
  - Chen-Yu Tsai <wens@csie.org>

description: |
  DE352 keeps mixer/display module clocks in the DETOP register block at
  DE + 0x8000 (RESET/CLK/MBUS), not at the DE2/DE3 clock@0 layout.

properties:
  "#clock-cells":
    const: 1

  "#reset-cells":
    const: 1

  compatible:
    const: allwinner,sun60i-a733-de352-clk

  reg:
    maxItems: 1

  clocks:
    items:
      - description: DE AHB fabric gate (CLK_DE_AHB_GATE)
      - description: DE MBUS fabric gate (CLK_MBUS_DESYS_GATE)
      - description: DE bus clock (CLK_BUS_DE0)
      - description: DE module clock (CLK_DE0)

  clock-names:
    items:
      - const: ahb
      - const: mbus
      - const: bus
      - const: mod

  resets:
    items:
      - description: DE system reset (RST_BUS_DE_SY)
      - description: DE0 bus reset (RST_BUS_DE0)

  reset-names:
    items:
      - const: sys
      - const: bus

  power-domains:
    maxItems: 1

required:
  - "#clock-cells"
  - "#reset-cells"
  - compatible
  - reg
  - clocks
  - clock-names
  - resets
  - reset-names

additionalProperties: false

examples:
  - |
    #include <dt-bindings/clock/sun60i-a733-ccu.h>
    #include <dt-bindings/reset/sun60i-a733-ccu.h>

    bus@5000000 {
        #address-cells = <1>;
        #size-cells = <1>;
        ranges = <0x0 0x0 0x05000000 0x400000>;

        de352_clocks: clock@8000 {
            compatible = "allwinner,sun60i-a733-de352-clk";
            reg = <0x8000 0x100>;
            clocks = <&ccu CLK_DE_AHB_GATE>,
                     <&ccu CLK_MBUS_DESYS_GATE>,
                     <&ccu CLK_BUS_DE0>,
                     <&ccu CLK_DE0>;
            clock-names = "ahb",
                          "mbus",
                          "bus",
                          "mod";
            resets = <&ccu RST_BUS_DE_SY>,
                     <&ccu RST_BUS_DE0>;
            reset-names = "sys", "bus";
            #clock-cells = <1>;
            #reset-cells = <1>;
        };
    };

...
```

## Documentation/devicetree/bindings/crypto/allwinner,sun60i-a733-crypto.yaml
```yaml
# SPDX-License-Identifier: GPL-2.0
%YAML 1.2
---
$id: http://devicetree.org/schemas/crypto/allwinner,sun60i-a733-crypto.yaml#
$schema: http://devicetree.org/meta-schemas/core.yaml#

title: Allwinner A733 Crypto Engine

maintainers:
  - Corentin Labbe <clabbe.montjoie@gmail.com>

properties:
  compatible:
    const: allwinner,sun60i-a733-crypto

  reg:
    maxItems: 1

  interrupts:
    maxItems: 1

  clocks:
    items:
      - description: Bus clock
      - description: Crypto Engine module clock
      - description: MBUS clock
      - description: Crypto Engine system clock

  clock-names:
    items:
      - const: bus
      - const: mod
      - const: ram
      - const: sys

  resets:
    maxItems: 1

required:
  - compatible
  - reg
  - interrupts
  - clocks
  - clock-names
  - resets

additionalProperties: false

examples:
  - |
    #include <dt-bindings/clock/sun60i-a733-ccu.h>
    #include <dt-bindings/interrupt-controller/arm-gic.h>
    #include <dt-bindings/reset/sun60i-a733-ccu.h>

    crypto@4603000 {
        compatible = "allwinner,sun60i-a733-crypto";
        reg = <0x04603000 0x100>;
        interrupts = <GIC_SPI 168 IRQ_TYPE_EDGE_RISING>;
        clocks = <&ccu CLK_BUS_CE>, <&ccu CLK_CE>,
                 <&ccu CLK_MBUS_CE>, <&ccu CLK_CE_SYS>;
        clock-names = "bus", "mod", "ram", "sys";
        resets = <&ccu RST_BUS_CE>;
    };
```

## Documentation/devicetree/bindings/display/allwinner,sun60i-a733-de352-mixer.yaml
```yaml
# SPDX-License-Identifier: GPL-2.0
%YAML 1.2
---
$id: http://devicetree.org/schemas/display/allwinner,sun60i-a733-de352-mixer.yaml#
$schema: http://devicetree.org/meta-schemas/core.yaml#

title: Allwinner A733 DE352 Mixer

maintainers:
  - Chen-Yu Tsai <wens@csie.org>

description: |
  DE352 mixer / display pipe for A733. DT shape follows the T527 A523
  de33-mixer-0 node (engine/top/display/detop), but the driver is sun60i_de
  (DE352 RCQ), not sun8i_mixer.

properties:
  compatible:
    const: allwinner,sun60i-a733-de352-mixer-0

  reg:
    items:
      - description: Channel / overlay engine (DE + 0x100000)
      - description: RTMX top (DE + 0x8100)
      - description: Display blender / formatter (DE + 0x280000)
      - description: DETOP mux block (DE + 0x8000); overlaps de352-clk

  reg-names:
    items:
      - const: engine
      - const: top
      - const: display
      - const: detop

  clocks:
    minItems: 2
    maxItems: 2

  clock-names:
    items:
      - const: bus
      - const: mod

  resets:
    maxItems: 1

  reset-names:
    items:
      - const: mod

  iommus:
    maxItems: 1

  power-domains:
    maxItems: 1

  chn_cfg_mode:
    $ref: /schemas/types.yaml#/definitions/uint32
    description: DE352 channel topology selected for this mixer.

  allwinner,tcon-id:
    $ref: /schemas/types.yaml#/definitions/uint32
    maximum: 15
    description: |
      Hardware TCON device index programmed into the DE2TCON mux for display
      pipe 0. This is a hardware device index, not an OF graph endpoint ID.
      A733 TCON-LCD0/1/2 use 0/1/2 respectively.

  ports:
    $ref: /schemas/graph.yaml#/properties/ports

required:
  - compatible
  - reg
  - reg-names
  - clocks
  - clock-names
  - resets
  - reset-names

additionalProperties: true

...
```

## arch/arm64/configs/a733_minimal_defconfig
```kconfig
CONFIG_SYSVIPC=y
CONFIG_NO_HZ_IDLE=y
CONFIG_HIGH_RES_TIMERS=y
CONFIG_BPF_SYSCALL=y
CONFIG_BPF_JIT=y
CONFIG_PREEMPT=y
CONFIG_IRQ_TIME_ACCOUNTING=y
CONFIG_BSD_PROCESS_ACCT=y
CONFIG_BSD_PROCESS_ACCT_V3=y
CONFIG_IKCONFIG=y
CONFIG_IKCONFIG_PROC=y
CONFIG_MEMCG=y
CONFIG_BLK_CGROUP=y
CONFIG_CGROUP_PIDS=y
CONFIG_CGROUP_FREEZER=y
CONFIG_CGROUP_HUGETLB=y
CONFIG_CPUSETS=y
CONFIG_CGROUP_DEVICE=y
CONFIG_CGROUP_CPUACCT=y
CONFIG_CGROUP_PERF=y
CONFIG_CGROUP_BPF=y
CONFIG_NAMESPACES=y
CONFIG_USER_NS=y
CONFIG_SCHED_AUTOGROUP=y
CONFIG_BLK_DEV_INITRD=y
# CONFIG_RD_BZIP2 is not set
# CONFIG_RD_LZMA is not set
# CONFIG_RD_XZ is not set
# CONFIG_RD_LZO is not set
# CONFIG_RD_LZ4 is not set
# CONFIG_RD_ZSTD is not set
CONFIG_EXPERT=y
CONFIG_KALLSYMS_ALL=y
CONFIG_KEXEC_FILE=y
CONFIG_ARCH_SUNXI=y
CONFIG_COMPAT=y
CONFIG_RANDOMIZE_BASE=y
# CONFIG_EFI is not set
# CONFIG_SUSPEND is not set
CONFIG_PM=y
CONFIG_CPU_FREQ=y
CONFIG_CPU_FREQ_STAT=y
CONFIG_CPU_FREQ_DEFAULT_GOV_SCHEDUTIL=y
CONFIG_CPUFREQ_DT=y
CONFIG_CPUFREQ_DT_PLATDEV=y
CONFIG_ARM_ALLWINNER_SUN60I_CPUFREQ_NVMEM=y
CONFIG_ARM_ALLWINNER_SUNXI_DSUFREQ=y
CONFIG_MODULES=y
CONFIG_MODULE_UNLOAD=y
# CONFIG_CORE_DUMP_DEFAULT_ELF_HEADERS is not set
# CONFIG_COMPAT_BRK is not set
CONFIG_KSM=y
CONFIG_TRANSPARENT_HUGEPAGE=y
CONFIG_CMA=y
CONFIG_CMA_SIZE_MBYTES=64
CONFIG_DMA_CMA=y
CONFIG_DMABUF_HEAPS=y
CONFIG_DMABUF_HEAPS_SYSTEM=y
CONFIG_DMABUF_HEAPS_CMA=y
CONFIG_DEVTMPFS=y
CONFIG_DEVTMPFS_MOUNT=y
CONFIG_FW_LOADER_USER_HELPER=y
CONFIG_ARM_SCMI_PROTOCOL=y
CONFIG_GOOGLE_FIRMWARE=y
CONFIG_GOOGLE_CBMEM=y
CONFIG_GOOGLE_COREBOOT_TABLE=y
CONFIG_OF_OVERLAY=y
CONFIG_BLK_DEV_LOOP=y
CONFIG_BLK_DEV_SD=y
CONFIG_SRAM=y
CONFIG_INPUT=y
CONFIG_I2C=y
CONFIG_I2C_CHARDEV=y
CONFIG_INPUT_EVDEV=y
CONFIG_KEYBOARD_MTK_PMIC=y
CONFIG_INPUT_TOUCHSCREEN=y
CONFIG_INPUT_MISC=y
# CONFIG_SERIO_SERPORT is not set
CONFIG_SERIO_AMBAKMI=y
CONFIG_LEGACY_PTY_COUNT=16
CONFIG_SERIAL_8250=y
CONFIG_SERIAL_8250_CONSOLE=y
CONFIG_SERIAL_8250_NR_UARTS=8
CONFIG_SERIAL_8250_EXTENDED=y
CONFIG_SERIAL_8250_SHARE_IRQ=y
CONFIG_SERIAL_8250_DW=y
CONFIG_SERIAL_OF_PLATFORM=y
CONFIG_SERIAL_DEV_BUS=y
CONFIG_HW_RANDOM=y
CONFIG_TCG_TPM=y
CONFIG_TCG_TIS=y
# CONFIG_PINCTRL_SUN8I_H3_R is not set
# CONFIG_PINCTRL_SUN50I_A64 is not set
# CONFIG_PINCTRL_SUN50I_A64_R is not set
# CONFIG_PINCTRL_SUN50I_A100 is not set
# CONFIG_PINCTRL_SUN50I_A100_R is not set
# CONFIG_PINCTRL_SUN50I_H5 is not set
# CONFIG_PINCTRL_SUN50I_H6 is not set
# CONFIG_PINCTRL_SUN50I_H6_R is not set
# CONFIG_PINCTRL_SUN50I_H616 is not set
# CONFIG_PINCTRL_SUN50I_H616_R is not set
# CONFIG_PINCTRL_SUN55I_A523 is not set
CONFIG_PINCTRL_SUN55I_A523_R=y
CONFIG_PINCTRL_SUN60I_A733=y
CONFIG_GPIO_SYSFS=y
CONFIG_WATCHDOG=y
CONFIG_WATCHDOG_SYSFS=y
CONFIG_SUNXI_WATCHDOG=y
CONFIG_POWER_RESET_XGENE=y
CONFIG_POWER_RESET_SYSCON=y
CONFIG_POWER_RESET_SYSCON_POWEROFF=y
CONFIG_SYSCON_REBOOT_MODE=y
CONFIG_NVMEM_REBOOT_MODE=y
CONFIG_NVMEM=y
CONFIG_NVMEM_SUNXI_SID=y
CONFIG_MFD_AXP20X_RSB=y
CONFIG_MFD_AXP20X_I2C=y
CONFIG_MFD_HI6421_PMIC=y
CONFIG_MFD_MT6397=y
CONFIG_INPUT_AXP20X_PEK=y
CONFIG_POWER_SUPPLY=y
CONFIG_REGULATOR=y
CONFIG_REGULATOR_FIXED_VOLTAGE=y
CONFIG_REGULATOR_AXP20X=y
# CONFIG_REGULATOR_SUN20I is not set
# CONFIG_HID_SUPPORT is not set
CONFIG_USB_CONN_GPIO=y
CONFIG_USB=y
CONFIG_USB_XHCI_HCD=y
CONFIG_USB_EHCI_HCD=y
CONFIG_USB_EHCI_HCD_PLATFORM=y
CONFIG_USB_OHCI_HCD=y
CONFIG_USB_OHCI_HCD_PLATFORM=y
CONFIG_USB_SUN60I_HCD=y
CONFIG_EXTCON=y
CONFIG_EXTCON_USB_GPIO=y
CONFIG_PHY_SUN4I_USB=y
CONFIG_USB_STORAGE=y
CONFIG_USB_DWC3=y
CONFIG_USB_SERIAL=y
CONFIG_USB_SERIAL_GENERIC=y
CONFIG_USB_SERIAL_CP210X=y
CONFIG_USB_SERIAL_FTDI_SIO=y
CONFIG_USB_GADGET=y
CONFIG_USB_CONFIGFS=y
CONFIG_USB_CONFIGFS_ACM=y
CONFIG_TYPEC=y
CONFIG_TYPEC_TCPM=y
CONFIG_TYPEC_TCPCI=y
CONFIG_TYPEC_RT1711H=y
CONFIG_MMC=y
CONFIG_MMC_SDHCI=y
CONFIG_MMC_SUNXI=y
# CONFIG_VIRTIO_MENU is not set
# CONFIG_VHOST_MENU is not set
# CONFIG_SURFACE_PLATFORMS is not set
# CONFIG_ARM64_PLATFORM_DEVICES is not set
CONFIG_COMMON_CLK_SCMI=y
CONFIG_COMMON_CLK_XGENE=y
# CONFIG_SUN50I_A64_CCU is not set
# CONFIG_SUN50I_A100_CCU is not set
# CONFIG_SUN50I_A100_R_CCU is not set
# CONFIG_SUN50I_H6_CCU is not set
# CONFIG_SUN50I_H616_CCU is not set
# CONFIG_SUN50I_H6_R_CCU is not set
# CONFIG_SUN55I_A523_CCU is not set
# CONFIG_SUN55I_A523_MCU_CCU is not set
# CONFIG_SUN55I_A523_R_CCU is not set
CONFIG_SUN60I_A733_CPUPLL_CCU=y
# CONFIG_SUN6I_RTC_CCU is not set
# CONFIG_SUN8I_H3_CCU is not set
# CONFIG_SUN8I_DE2_CCU is not set
CONFIG_PHY_CAN_TRANSCEIVER=y
CONFIG_PHY_CADENCE_TORRENT=y
CONFIG_PHY_CADENCE_DPHY=y
CONFIG_PHY_CADENCE_DPHY_RX=y
CONFIG_PHY_CADENCE_SIERRA=y
CONFIG_PHY_CADENCE_SALVO=y
CONFIG_ARM_CCI_PMU=y
CONFIG_ARM_CCN=y
CONFIG_ARM_CMN=y
CONFIG_ARM_SMMU_V3_PMU=y
CONFIG_ARM_DSU_PMU=y
CONFIG_ARM_SPE_PMU=y
CONFIG_ARM_CORESIGHT_PMU_ARCH_SYSTEM_PMU=y
CONFIG_NVIDIA_CORESIGHT_PMU_ARCH_SYSTEM_PMU=y
CONFIG_MUX_MMIO=y
CONFIG_EXT4_FS=y
CONFIG_EXT4_FS_POSIX_ACL=y
CONFIG_EXT4_FS_SECURITY=y
CONFIG_FANOTIFY=y
CONFIG_FANOTIFY_ACCESS_PERMISSIONS=y
CONFIG_QUOTA=y
CONFIG_AUTOFS_FS=y
CONFIG_VFAT_FS=y
CONFIG_HUGETLBFS=y
# CONFIG_MISC_FILESYSTEMS is not set
CONFIG_NLS_CODEPAGE_437=y
CONFIG_NLS_ISO8859_1=y
CONFIG_SECURITY=y
# CONFIG_CRYPTO_HW is not set
CONFIG_DMA_RESTRICTED_POOL=y
CONFIG_PRINTK_TIME=y
CONFIG_DEBUG_INFO_DWARF_TOOLCHAIN_DEFAULT=y
CONFIG_DEBUG_INFO_REDUCED=y
CONFIG_MAGIC_SYSRQ=y
CONFIG_DEBUG_FS=y
CONFIG_DEBUG_MEMORY_INIT=y
# CONFIG_FTRACE is not set
CONFIG_CORESIGHT=y
CONFIG_CORESIGHT_LINK_AND_SINK_TMC=y
CONFIG_CORESIGHT_CATU=y
CONFIG_CORESIGHT_SINK_TPIU=y
CONFIG_CORESIGHT_SINK_ETBV10=y
CONFIG_CORESIGHT_STM=y
CONFIG_CORESIGHT_CPU_DEBUG=y
CONFIG_CORESIGHT_CTI=y
CONFIG_MEMTEST=y
CONFIG_NET=y
CONFIG_PACKET=y
CONFIG_UNIX=y
CONFIG_INET=y
CONFIG_PROC_FS=y
# CONFIG_PROC_KCORE is not set
CONFIG_PROC_VMCORE=y
# CONFIG_PROC_VMCORE_DEVICE_DUMP is not set
CONFIG_PROC_SYSCTL=y
CONFIG_PROC_PAGE_MONITOR=y
# CONFIG_PROC_CHILDREN is not set
CONFIG_PROC_PID_ARCH_STATUS=y
CONFIG_KERNFS=y
CONFIG_SYSFS=y
CONFIG_TMPFS=y
CONFIG_TMPFS_POSIX_ACL=y
CONFIG_TMPFS_XATTR=y
CONFIG_TMPFS_INODE64=y
CONFIG_TMPFS_QUOTA=y
CONFIG_I2C_MV64XXX=y
CONFIG_SPI=y
CONFIG_SPI_SUN6I=y
CONFIG_HWSPINLOCK=y
CONFIG_HWSPINLOCK_SUN6I=y
CONFIG_MAILBOX=y
CONFIG_SUNXI_MSGBOX=y
CONFIG_REMOTEPROC=y
CONFIG_REMOTEPROC_CDEV=y
CONFIG_AW_REMOTEPROC=y
CONFIG_AW_REMOTEPROC_ARM_BOOT=y
CONFIG_AW_RPROC_ENHANCED_TRACE=y
CONFIG_AW_RPMSG_VIRTIO=y
CONFIG_AW_RPMSG_CTRL=y
CONFIG_AW_RPMSG_CLASS=y
CONFIG_AW_RPMSG_NOTIFY=y
CONFIG_RTC_CLASS=y
CONFIG_RTC_DRV_SUN60I=y
CONFIG_DMADEVICES=y
CONFIG_DMA_SUN6I=y
CONFIG_RESET_CONTROLLER=y
CONFIG_PWM=y
CONFIG_PWM_SUNXI=y
CONFIG_HAS_IOMEM=y
CONFIG_SCSI=y
CONFIG_SCSI_DMA=y
CONFIG_MTD=y
CONFIG_SPI_MASTER=y
CONFIG_MTD_SPI_NOR=y
CONFIG_SPI_SUNXI_SPIF=y
CONFIG_IOMMU_IOVA=y
CONFIG_IOMMU_API=y
CONFIG_IOMMU_DMA=y
CONFIG_IOMMU_SUPPORT=y
CONFIG_IOMMU_IO_PGTABLE=y
CONFIG_IOMMU_DEBUGFS=y
CONFIG_SUNXI_IOMMU=y
CONFIG_PM_GENERIC_DOMAINS=y
CONFIG_SUN55I_PCK600=y
CONFIG_DRM=y
CONFIG_DRM_POWERVR=m
CONFIG_MEDIA_SUPPORT=y
CONFIG_MEDIA_CAMERA_SUPPORT=y
CONFIG_MEDIA_CONTROLLER=y
CONFIG_MEDIA_PLATFORM_DRIVERS=y
CONFIG_VIDEO_V4L2_SUBDEV_API=y
CONFIG_V4L2_FWNODE=y
CONFIG_VIDEO_DEV=y
CONFIG_VIDEO_SUN60I_VIN=y
CONFIG_CSI_VIN=y
CONFIG_SUPPORT_ISP_TDM=y
CONFIG_VIN_IOMMU=y
CONFIG_VIDEO_SUN60I_CEDAR_VE=y
CONFIG_VIDEO_SUN60I_CEDAR_VE_DEBUG=y
# CONFIG_VIDEO_SUN60I_CEDAR_VE_KERNEL_ENC is not set
# CONFIG_VIDEO_SUN60I_CEDAR_VE_KERNEL_DEC is not set
CONFIG_AW_NNA_VIP=m
# CONFIG_NPU_SET_CLK_VOL is not set
CONFIG_AW_NNA_GALCORE=m
CONFIG_PM_DEVFREQ=y
CONFIG_DEVFREQ_GOV_SIMPLE_ONDEMAND=y
CONFIG_DEVFREQ_GOV_PERFORMANCE=y
CONFIG_DEVFREQ_THERMAL=y
CONFIG_HWMON=y
CONFIG_IIO=y
CONFIG_SUN20I_GPADC=y
CONFIG_KEYBOARD_SUNXI_LRADC=y
CONFIG_RC_CORE=y
CONFIG_RC_DECODERS=y
CONFIG_IR_NEC_DECODER=y
CONFIG_IR_RC5_DECODER=y
CONFIG_RC_DEVICES=y
CONFIG_IR_SUNXI_RX=y
CONFIG_IR_SUNXI_TX=y
CONFIG_SUNXI_NSI=y
CONFIG_THERMAL=y
CONFIG_THERMAL_OF=y
CONFIG_THERMAL_HWMON=y
CONFIG_CPU_THERMAL=y
CONFIG_SUN8I_THERMAL=y
CONFIG_SOUND=y
CONFIG_SND=y
CONFIG_SND_SOC=y
CONFIG_SND_SUN4I_I2S=y
CONFIG_SND_SUN50I_DMIC=y
CONFIG_SND_SUN60I_A733_CODEC=y
CONFIG_SND_SOC_DMIC=y
CONFIG_SND_SIMPLE_CARD=y
CONFIG_SND_SIMPLE_CARD_UTILS=y
```

## drivers/bus/sunxi/Kconfig
```kconfig
# SPDX-License-Identifier: GPL-2.0-only

config ARCH_SUN60IW2
	bool
	depends on ARCH_SUNXI
	default y if SUN60I_A733_CCU

config SUNXI_NSI
	tristate "Allwinner NSI interconnect driver (A733)"
	depends on SUN60I_A733_CCU
	select ARCH_SUN60IW2
	select HWMON
	help
	  Say Y here to enable the Allwinner Network System Interconnect
	  (NSI) driver for the A733. NSI manages bus bandwidth and priority
	  between masters such as CPU, GPU, NPU and multimedia blocks.
```
