## drivers/crypto/allwinner/Kconfig
```kconfig
config CRYPTO_DEV_ALLWINNER
	bool "Support for Allwinner cryptographic offloader"
	depends on ARCH_SUNXI || COMPILE_TEST
	default y if ARCH_SUNXI
	help
	  Say Y here to get to see options for Allwinner hardware crypto devices

config CRYPTO_DEV_SUN4I_SS
	tristate "Support for Allwinner Security System cryptographic accelerator"
	depends on ARCH_SUNXI
	depends on PM
	depends on CRYPTO_DEV_ALLWINNER
	select CRYPTO_MD5
	select CRYPTO_SHA1
	select CRYPTO_AES
	select CRYPTO_LIB_DES
	select CRYPTO_SKCIPHER
	help
	  Some Allwinner SoC have a crypto accelerator named
	  Security System. Select this if you want to use it.
	  The Security System handle AES/DES/3DES ciphers in CBC mode
	  and SHA1 and MD5 hash algorithms.

	  To compile this driver as a module, choose M here: the module
	  will be called sun4i-ss.

config CRYPTO_DEV_SUN4I_SS_PRNG
	bool "Support for Allwinner Security System PRNG"
	depends on CRYPTO_DEV_SUN4I_SS
	select CRYPTO_RNG
	help
	  Select this option if you want to provide kernel-side support for
	  the Pseudo-Random Number Generator found in the Security System.

config CRYPTO_DEV_SUN4I_SS_DEBUG
	bool "Enable sun4i-ss stats"
	depends on CRYPTO_DEV_SUN4I_SS
	depends on DEBUG_FS
	help
	  Say y to enable sun4i-ss debug stats.
	  This will create /sys/kernel/debug/sun4i-ss/stats for displaying
	  the number of requests per algorithm.

config CRYPTO_DEV_SUN8I_CE
	tristate "Support for Allwinner Crypto Engine cryptographic offloader"
	select CRYPTO_SKCIPHER
	select CRYPTO_ENGINE
	select CRYPTO_ECB
	select CRYPTO_CBC
	select CRYPTO_AES
	select CRYPTO_DES
	depends on CRYPTO_DEV_ALLWINNER
	depends on PM
	help
	  Select y here to have support for the crypto Engine available on
	  Allwinner SoC H2+, H3, H5, H6, R40 and A64.
	  The Crypto Engine handle AES/3DES ciphers in ECB/CBC mode.

	  To compile this driver as a module, choose M here: the module
	  will be called sun8i-ce.

config CRYPTO_DEV_SUN8I_CE_DEBUG
	bool "Enable sun8i-ce stats"
	depends on CRYPTO_DEV_SUN8I_CE
	depends on DEBUG_FS
	help
	  Say y to enable sun8i-ce debug stats.
	  This will create /sys/kernel/debug/sun8i-ce/stats for displaying
	  the number of requests per flow and per algorithm.

config CRYPTO_DEV_SUN8I_CE_HASH
	bool "Enable support for hash on sun8i-ce"
	depends on CRYPTO_DEV_SUN8I_CE
	select CRYPTO_MD5
	select CRYPTO_SHA1
	select CRYPTO_SHA256
	select CRYPTO_SHA512
	help
	  Say y to enable support for hash algorithms.

config CRYPTO_DEV_SUN8I_CE_PRNG
	bool "Support for Allwinner Crypto Engine PRNG"
	depends on CRYPTO_DEV_SUN8I_CE
	select CRYPTO_RNG
	help
	  Select this option if you want to provide kernel-side support for
	  the Pseudo-Random Number Generator found in the Crypto Engine.

config CRYPTO_DEV_SUN8I_CE_TRNG
	bool "Support for Allwinner Crypto Engine TRNG"
	depends on CRYPTO_DEV_SUN8I_CE
	select HW_RANDOM
	help
	  Select this option if you want to provide kernel-side support for
	  the True Random Number Generator found in the Crypto Engine.

config CRYPTO_DEV_SUN60I_CE
	tristate "Support for Allwinner A733 Crypto Engine"
	select CRYPTO_SKCIPHER
	select CRYPTO_ENGINE
	select CRYPTO_ECB
	select CRYPTO_CBC
	select CRYPTO_AES
	select CRYPTO_DES
	depends on CRYPTO_DEV_ALLWINNER
	depends on PM
	help
	  Select Y or M to enable the Crypto Engine found in the Allwinner
	  A733 SoC. The engine handles AES and 3DES in ECB/CBC mode, hash
	  algorithms, and hardware random-number generation. Requests are
	  submitted asynchronously through the kernel crypto engine API.

	  To compile this driver as a module, choose M here: the module
	  will be called sun60i-ce.

config CRYPTO_DEV_SUN60I_CE_DEBUG
	bool "Enable sun60i-ce stats"
	depends on CRYPTO_DEV_SUN60I_CE
	depends on DEBUG_FS
	help
	  Say Y to expose per-channel, per-algorithm, fallback, and random
	  number generator counters in debugfs. This is intended for driver
	  development and performance diagnostics. The counters are available
	  under the sun60i-ce debugfs directory.

config CRYPTO_DEV_SUN60I_CE_HASH
	bool "Enable support for hash on sun60i-ce"
	depends on CRYPTO_DEV_SUN60I_CE
	select CRYPTO_MD5
	select CRYPTO_SHA1
	select CRYPTO_SHA256
	select CRYPTO_SHA512
	help
	  Say Y to enable hardware-accelerated MD5, SHA1, SHA224, SHA256,
	  SHA384, and SHA512 one-shot digest operations. Streaming requests
	  remain available through the software fallback implementation.
	  This option is built into the sun60i-ce module.

config CRYPTO_DEV_SUN60I_CE_PRNG
	bool "Support for Allwinner sun60i-ce PRNG"
	depends on CRYPTO_DEV_SUN60I_CE
	select CRYPTO_RNG
	help
	  Say Y to register the A733 CE pseudo-random number generator with
	  the kernel crypto API. The generator accepts the hardware-defined
	  175-bit seed and returns data in 160-bit blocks. This option is
	  built into the sun60i-ce module.

config CRYPTO_DEV_SUN60I_CE_TRNG
	bool "Support for Allwinner sun60i-ce TRNG"
	depends on CRYPTO_DEV_SUN60I_CE
	select HW_RANDOM
	help
	  Say Y to register the A733 CE true-random number generator through
	  the kernel hwrng framework. Output is requested in the 256-bit
	  multiples required by the hardware. This option is built into the
	  sun60i-ce module.

config CRYPTO_DEV_SUN8I_SS
	tristate "Support for Allwinner Security System cryptographic offloader"
	select CRYPTO_SKCIPHER
	select CRYPTO_ENGINE
	select CRYPTO_ECB
	select CRYPTO_CBC
	select CRYPTO_AES
	select CRYPTO_DES
	depends on CRYPTO_DEV_ALLWINNER
	depends on PM
	help
	  Select y here to have support for the Security System available on
	  Allwinner SoC A80, A83T.
	  The Security System handle AES/3DES ciphers in ECB/CBC mode.

	  To compile this driver as a module, choose M here: the module
	  will be called sun8i-ss.

config CRYPTO_DEV_SUN8I_SS_DEBUG
	bool "Enable sun8i-ss stats"
	depends on CRYPTO_DEV_SUN8I_SS
	depends on DEBUG_FS
	help
	  Say y to enable sun8i-ss debug stats.
	  This will create /sys/kernel/debug/sun8i-ss/stats for displaying
	  the number of requests per flow and per algorithm.

config CRYPTO_DEV_SUN8I_SS_PRNG
	bool "Support for Allwinner Security System PRNG"
	depends on CRYPTO_DEV_SUN8I_SS
	select CRYPTO_RNG
	help
	  Select this option if you want to provide kernel-side support for
	  the Pseudo-Random Number Generator found in the Security System.

config CRYPTO_DEV_SUN8I_SS_HASH
	bool "Enable support for hash on sun8i-ss"
	depends on CRYPTO_DEV_SUN8I_SS
	select CRYPTO_MD5
	select CRYPTO_SHA1
	select CRYPTO_SHA256
	help
	  Say y to enable support for hash algorithms.
```

## drivers/media/platform/sunxi/cedar-ve/Kconfig
```kconfig
# SPDX-License-Identifier: GPL-2.0-only
#
# Allwinner cedar-ve (A733 / sun60iw2)
#

config VIDEO_SUN60I_CEDAR_VE
	tristate "Allwinner sun60i cedar-ve video encoder/decoder"
	depends on ARCH_SUNXI || COMPILE_TEST
	depends on HAS_DMA
	select DMA_SHARED_BUFFER
	select ARCH_SUN60IW2
	help
	  Char-device driver for Allwinner A733 (sun60iw2) video engine:
	  creates /dev/cedar_dev (decode) and /dev/cedar_dev_ve2 (encode).
	  Userspace needs CedarX / libcedarc.

if VIDEO_SUN60I_CEDAR_VE

config VIDEO_SUN60I_CEDAR_VE_KERNEL_ENC
	bool "In-kernel video encoder module"
	default n
	help
	  Enable sunxi in-kernel encoder blobs (not used on OpenTina A733).

config VIDEO_SUN60I_CEDAR_VE_KERNEL_DEC
	bool "In-kernel video decoder module"
	default n
	help
	  Enable sunxi in-kernel decoder blobs (not used on OpenTina A733).

config VIDEO_SUN60I_CEDAR_VE_DEBUG
	bool "Enable cedar-ve dynamic debug"
	depends on DYNAMIC_DEBUG
	default y

endif # VIDEO_SUN60I_CEDAR_VE
```

## drivers/media/platform/sunxi/sun60i-vin/Kconfig
```kconfig
# SPDX-License-Identifier: GPL-2.0-only
#
# Allwinner sun60i VIN (CSI / MIPI / ISP / VIPP) for A733 / sun60iw2
#

menuconfig VIDEO_SUN60I_VIN
	tristate "Allwinner sun60i VIN (CSI/MIPI/ISP/VIPP) camera driver"
	depends on ARCH_SUNXI || COMPILE_TEST
	depends on VIDEO_DEV
	depends on MEDIA_CAMERA_SUPPORT
	select VIDEOBUF2_DMA_CONTIG
	help
	  Hawkview video input pipeline for Allwinner A733 (sun60iw2):
	  MIPI CSI-2 combo PHY, CSI parser, ISP600, VIPP scaler, and VIN DMA.

if VIDEO_SUN60I_VIN

config ARCH_SUN60IW2
	bool
	default y
	help
	  Select sun60iw2 register layout and combo CSI / ISP600 backends.

config CSI_VIN
	tristate "V4L2 VIN core"
	default y
	select VIDEOBUF2_DMA_CONTIG

config FLASH
	tristate "VIN flash helper"
	default n

config ACTUATOR
	tristate "VIN lens actuator"
	default n

config SENSOR_LIST
	tristate "Adaptive sensor list"
	default n

config VIN_LOG
	bool "Verbose VIN debug logging"
	depends on DYNAMIC_DEBUG
	default n

config SUPPORT_ISP_TDM
	bool "ISP TDM support"
	default y

config CSI_CCI
	tristate "Hardware CCI (alternative to I2C)"
	default n

config SENSOR_POWER
	tristate "VIN sensor power helper"
	default n

config VIN_IOMMU
	bool "Use IOMMU for VIN DMA buffers / master enable"
	depends on SUNXI_IOMMU
	default y
	help
	  Enable sunxi IOMMU master control for CSI/ISP (masters 1/2 on
	  A733). Buffer allocation still uses dma_alloc_coherent with the
	  device IOMMU mapping when DT provides iommus.

endif # VIDEO_SUN60I_VIN
```

## drivers/npu/Kconfig
```kconfig
# SPDX-License-Identifier: GPL-2.0

menu "NPU Drivers"

source "drivers/npu/vipcore/Kconfig"
source "drivers/npu/galcore/Kconfig"

endmenu
```

## drivers/npu/galcore/Kconfig
```kconfig
# SPDX-License-Identifier: GPL-2.0

config AW_NNA_GALCORE
	tristate "Allwinner A733 NNA galcore (Vivante GAL) driver"
	depends on ARCH_SUNXI || COMPILE_TEST
	depends on OF
	depends on NVMEM
	select SYNC_FILE
	select ARCH_SUN60IW2
	default n
	help
	  Optional Vivante galcore NPU driver (module galcore) for A733.
	  Compatible with the same DT node as AW_NNA_VIP (allwinner,npu).
	  Do not load vipcore and galcore against the same device at once.
```

## drivers/npu/vipcore/Kconfig
```kconfig
# SPDX-License-Identifier: GPL-2.0

config AW_NNA_VIP
	tristate "Allwinner A733 NNA VIP2 (Vivante VIPLite) driver"
	depends on ARCH_SUNXI || COMPILE_TEST
	depends on OF
	depends on NVMEM
	select DMA_SHARED_BUFFER
	select PM_OPP
	select PM_DEVFREQ
	select DEVFREQ_GOV_SIMPLE_ONDEMAND
	select DEVFREQ_THERMAL
	select ARCH_SUN60IW2
	default n
	help
	  Vivante VIPLite v2 driver (module vipcore) for Allwinner A733
	  / sun60iw2 on-chip NPU. Compatible with DT node "allwinner,npu".
	  DVFS grade is read from SID via the existing nvmem sunxi_sid
	  provider (nvmem-cell "dvfs").

config NPU_SET_CLK_VOL
	bool "NPU set clock / voltage from driver"
	depends on AW_NNA_VIP
	default n
	help
	  Allow the VIP platform driver to program NPU clock and voltage
	  without clk_round_rate clamping.
```

## drivers/pci/controller/allwinner/Kconfig
```kconfig
# SPDX-License-Identifier: GPL-2.0-only
# Copyright (C) 2015-2025 Allwinner Technology Co., Ltd.

menu "Allwinner PCIe Drivers"
	depends on PCI

choice
	prompt "Allwinner PCIe controller support"
	default PCIE_SUNXI_NONE

config PCIE_SUNXI_RC
	bool "RC controller - Host mode"
	help
	  Enables support for the PCIe RC controller in the Allwinner SoC.

config PCIE_SUNXI_EP
	bool "EP controller - Endpoint mode"
	select PCI_ENDPOINT
	help
	  Enables support for the PCIe EP controller in the Allwinner SoC.

config PCIE_SUNXI_NONE
	bool "None"
	help
	  Disable support for the PCIe controller in the Allwinner SoC.

endchoice

endmenu
```

## drivers/pinctrl/sunxi-vendor/Kconfig
```kconfig
# SPDX-License-Identifier: GPL-2.0-only
if ARCH_SUNXI

config PINCTRL_SUNXI_VENDOR
	bool "Allwinner Vendor pinctrl driver"
	select PINMUX
	select GENERIC_PINCONF
	select GPIOLIB

config PINCTRL_SUN60I_A733
	bool "Pinctrl support for Allwinner A733"
	depends on PINCTRL_SUNXI_VENDOR

config PINCTRL_SUN60I_A733_R
	bool "Pinctrl support for Allwinner A733 PRCM"
	depends on PINCTRL_SUNXI_VENDOR

endif
```
